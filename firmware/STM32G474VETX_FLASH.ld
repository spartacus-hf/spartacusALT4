/*
******************************************************************************
**
** @file        : LinkerScript.ld
**
** @author      : Auto-generated by STM32CubeIDE
**
** @brief       : SPARTACUS REV1 linker script for STM32G474VET6
**                      512KBytes FLASH, 96KBytes SRAM, 32KBytes CCM SRAM
**
**                Set heap size, stack size and stack location according
**                to application requirements.
**
**                Set memory bank area and size if external memory is used
**
**  Target      : STMicroelectronics STM32
**
**  Distribution: The file is distributed as is, without any warranty
**                of any kind.
**
******************************************************************************
** @attention
**
** Copyright (c) 2026 STMicroelectronics.
** All rights reserved.
**
** This software is licensed under terms that can be found in the LICENSE file
** in the root directory of this software component.
** If no LICENSE file comes with this software, it is provided AS-IS.
**
******************************************************************************
*/

/* Entry Point */
ENTRY(Reset_Handler)

/* Highest address of the user mode stack */
_estack = ORIGIN(RAM) + LENGTH(RAM); /* end of "RAM" Ram type memory */

_Min_Heap_Size = 0x200; /* required amount of heap */
_Min_Stack_Size = 0x1800; /* foreground chain plus interrupt-nesting margin */

/* Memories definition */
MEMORY
{
  RAM          (xrw) : ORIGIN = 0x20000000, LENGTH = 96K
  CCMRAM       (xrw) : ORIGIN = 0x10000000, LENGTH = 32K
  FLASH_LOADER (rx)  : ORIGIN = 0x08000000, LENGTH = 4K
  /* Layout 2 (v8.09, loader ABI 2): the application runs to the footer at
   * the end of bank-2 page 126; the update journal is the last page. The
   * settings and calibration that layout 1 kept in the last 44 KiB live on
   * the SD card (fw_update_format.h, mod_sd_store.c). */
  FLASH_APP    (rx)  : ORIGIN = 0x08001000, LENGTH = 0x7E7E0
  IMAGE_FOOTER (rx)  : ORIGIN = 0x0807F7E0, LENGTH = 32
  UPDATE_JOURNAL (rx): ORIGIN = 0x0807F800, LENGTH = 2K
}

/* Program headers are explicit so executable code and writable RAM/CCM
 * sections do not share a single RWX LOAD segment. RAM-only NOLOAD sections
 * are assigned to :NONE below to avoid flash LMAs and linker LMA-adjustment
 * diagnostics. */
PHDRS
{
  flash_rx PT_LOAD FLAGS(5);  /* R + X */
  ccm_rx   PT_LOAD FLAGS(5);  /* R + X */
  ram_rw   PT_LOAD FLAGS(6);  /* R + W */
}

/* Sections */
SECTIONS
{

  /* The startup code into "FLASH" Rom type memory */
  .isr_vector :
  {
    . = ALIGN(4);
    KEEP(*(.isr_vector)) /* Startup code */
    . = ALIGN(4);
  } >FLASH_APP :flash_rx

  /* The program code and other data into "FLASH" Rom type memory */
  .text :
  {
    . = ALIGN(4);
    *(.text)           /* .text sections (code) */
    *(.text*)          /* .text* sections (code) */
    *(.glue_7)         /* glue arm to thumb code */
    *(.glue_7t)        /* glue thumb to arm code */
    *(.eh_frame)

    KEEP (*(.init))
    KEEP (*(.fini))

    . = ALIGN(4);
    _etext = .;        /* define a global symbols at end of code */
  } >FLASH_APP :flash_rx

  /* Constant data into "FLASH" Rom type memory */
  .rodata :
  {
    . = ALIGN(4);
    *(.rodata)         /* .rodata sections (constants, strings, etc.) */
    *(.rodata*)        /* .rodata* sections (constants, strings, etc.) */
    . = ALIGN(4);
  } >FLASH_APP :flash_rx

  .ARM.extab (READONLY) : /* The "READONLY" keyword is only supported in GCC11 and later, remove it if using GCC10 or earlier. */
  {
    . = ALIGN(4);
    *(.ARM.extab* .gnu.linkonce.armextab.*)
    . = ALIGN(4);
  } >FLASH_APP :flash_rx

  .ARM (READONLY) : /* The "READONLY" keyword is only supported in GCC11 and later, remove it if using GCC10 or earlier. */
  {
    . = ALIGN(4);
    __exidx_start = .;
    *(.ARM.exidx*)
    __exidx_end = .;
    . = ALIGN(4);
  } >FLASH_APP :flash_rx

  .preinit_array (READONLY) : /* The "READONLY" keyword is only supported in GCC11 and later, remove it if using GCC10 or earlier. */
  {
    . = ALIGN(4);
    PROVIDE_HIDDEN (__preinit_array_start = .);
    KEEP (*(.preinit_array*))
    PROVIDE_HIDDEN (__preinit_array_end = .);
    . = ALIGN(4);
  } >FLASH_APP :flash_rx

  .init_array (READONLY) : /* The "READONLY" keyword is only supported in GCC11 and later, remove it if using GCC10 or earlier. */
  {
    . = ALIGN(4);
    PROVIDE_HIDDEN (__init_array_start = .);
    KEEP (*(SORT(.init_array.*)))
    KEEP (*(.init_array*))
    PROVIDE_HIDDEN (__init_array_end = .);
    . = ALIGN(4);
  } >FLASH_APP :flash_rx

  .fini_array (READONLY) : /* The "READONLY" keyword is only supported in GCC11 and later, remove it if using GCC10 or earlier. */
  {
    . = ALIGN(4);
    PROVIDE_HIDDEN (__fini_array_start = .);
    KEEP (*(SORT(.fini_array.*)))
    KEEP (*(.fini_array*))
    PROVIDE_HIDDEN (__fini_array_end = .);
    . = ALIGN(4);
  } >FLASH_APP :flash_rx

  /* Used by the startup to initialize data */
  _sidata = LOADADDR(.data);
  _siccmram_text = LOADADDR(.ccmram_text);

  .ccmram_text :
  {
    . = ALIGN(4);
    _sccmram_text = .;
    *(.ccmram_text)
    *(.ccmram_text*)
    . = ALIGN(4);
    _eccmram_text = .;
  } >CCMRAM AT> FLASH_APP :ccm_rx

  . = ALIGN(4);
  .ccmram_bss (NOLOAD) :
  {
    _sccmram_bss = .;
    *(.ccmram_bss)
    *(.ccmram_bss*)
    . = ALIGN(4);
    _eccmram_bss = .;
  } >CCMRAM :NONE

  /* Initialized data sections into "RAM" Ram type memory */
  .data :
  {
    . = ALIGN(4);
    _sdata = .;        /* create a global symbol at data start */
    *(.data)           /* .data sections */
    *(.data*)          /* .data* sections */
    *(.RamFunc)        /* .RamFunc sections */
    *(.RamFunc*)       /* .RamFunc* sections */

    . = ALIGN(4);
    _edata = .;        /* define a global symbol at data end */

  } >RAM AT> FLASH_APP :ram_rw

  /* Uninitialized data section into "RAM" Ram type memory */
  . = ALIGN(4);
  .bss (NOLOAD) :
  {
    /* This is used by the startup in order to initialize the .bss section */
    _sbss = .;         /* define a global symbol at bss start */
    __bss_start__ = _sbss;
    *(.bss)
    *(.bss*)
    *(COMMON)

    . = ALIGN(4);
    _ebss = .;         /* define a global symbol at bss end */
    __bss_end__ = _ebss;
  } >RAM :NONE

  .noinit (NOLOAD) :
  {
    . = ALIGN(4);
    *(.noinit)
    *(.noinit*)
    . = ALIGN(4);
  } >RAM :NONE

  /* User_heap_stack section, used to check that there is enough "RAM" Ram  type memory left */
  ._user_heap_stack (NOLOAD) :
  {
    . = ALIGN(8);
    PROVIDE ( end = . );
    PROVIDE ( _end = . );
    . = . + _Min_Heap_Size;
    . = . + _Min_Stack_Size;
    . = ALIGN(8);
  } >RAM :NONE

  .image_footer_reserve (NOLOAD) :
  {
    __image_footer_start__ = ORIGIN(IMAGE_FOOTER);
    . = ORIGIN(IMAGE_FOOTER) + LENGTH(IMAGE_FOOTER);
    __image_footer_end__ = .;
  } >IMAGE_FOOTER :NONE

  .update_journal_reserve (NOLOAD) :
  {
    __update_journal_start__ = ORIGIN(UPDATE_JOURNAL);
    . = ORIGIN(UPDATE_JOURNAL) + LENGTH(UPDATE_JOURNAL);
    __update_journal_end__ = .;
  } >UPDATE_JOURNAL :NONE

  ASSERT((ORIGIN(FLASH_LOADER) + LENGTH(FLASH_LOADER)) == ORIGIN(FLASH_APP), "Loader/application gap")
  ASSERT((ORIGIN(FLASH_APP) + LENGTH(FLASH_APP)) == ORIGIN(IMAGE_FOOTER), "Application/footer gap")
  ASSERT((ORIGIN(IMAGE_FOOTER) + LENGTH(IMAGE_FOOTER)) == ORIGIN(UPDATE_JOURNAL), "Footer/journal gap")
  ASSERT((ORIGIN(UPDATE_JOURNAL) + LENGTH(UPDATE_JOURNAL)) == 0x08080000, "The journal must be the last flash page")
  ASSERT((ORIGIN(UPDATE_JOURNAL) % 2048) == 0, "UPDATE_JOURNAL must be page aligned")

  /* Remove information from the compiler libraries */
  /DISCARD/ :
  {
    libc.a ( * )
    libm.a ( * )
    libgcc.a ( * )
  }

  .ARM.attributes 0 : { *(.ARM.attributes) }
}
